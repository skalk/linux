## drivers/gpu/drm/imx/dcss/Kconfig
```kconfig
config DRM_IMX_DCSS
	tristate "i.MX8MQ DCSS"
	select RESET_CONTROLLER
	select IMX_IRQSTEER
	select DRM_KMS_CMA_HELPER
	depends on DRM && ARCH_MXC
	help
	  Choose this if you have a NXP i.MX8MQ based system and want to use the
	  Display Controller Subsystem. This option enables DCSS support.
```
